## configs/domestic_recorder_defconfig
```kconfig
BR2_arm=y
BR2_cortex_a8=y
BR2_JLEVEL=16
BR2_OPTIMIZE_3=y
BR2_TOOLCHAIN_BUILDROOT_GLIBC=y
BR2_KERNEL_HEADERS_4_4=y
BR2_GCC_VERSION_6_X=y
BR2_EXTRA_GCC_CONFIG_OPTIONS="--with-fpu=vfpv3 --with-float=hard"
BR2_TOOLCHAIN_BUILDROOT_CXX=y
BR2_TARGET_GENERIC_HOSTNAME="domestic-recorder"
BR2_TARGET_GENERIC_ISSUE="Domestic Recorder by Domestic Affairs"
BR2_INIT_SYSTEMD=y
BR2_SYSTEM_BIN_SH_BASH=y
BR2_GENERATE_LOCALE="en_US"
BR2_ROOTFS_OVERLAY="domestic_recorder/fs-overlay"
BR2_PACKAGE_BUSYBOX_SELINUX=y
BR2_PACKAGE_ALSA_UTILS=y
BR2_PACKAGE_ALSA_UTILS_AMIXER=y
BR2_PACKAGE_ALSA_UTILS_APLAY=y
BR2_PACKAGE_FFMPEG=y
BR2_PACKAGE_FFMPEG_GPL=y
BR2_PACKAGE_FFMPEG_NONFREE=y
BR2_PACKAGE_FLAC=y
BR2_PACKAGE_PULSEAUDIO=y
BR2_PACKAGE_PULSEAUDIO_DAEMON=y
BR2_PACKAGE_SOX=y
BR2_PACKAGE_BZIP2=y
BR2_PACKAGE_GDB=y
BR2_PACKAGE_GDB_SERVER=y
BR2_PACKAGE_GDB_DEBUGGER=y
BR2_PACKAGE_GDB_TUI=y
BR2_PACKAGE_BINUTILS=y
BR2_PACKAGE_BINUTILS_TARGET=y
BR2_PACKAGE_CIFS_UTILS=y
BR2_PACKAGE_E2FSPROGS=y
BR2_PACKAGE_MTD=y
BR2_PACKAGE_SDL2=y
BR2_PACKAGE_LINUX_FIRMWARE=y
BR2_PACKAGE_LINUX_FIRMWARE_RALINK_RT61=y
BR2_PACKAGE_LINUX_FIRMWARE_RALINK_RT73=y
BR2_PACKAGE_LINUX_FIRMWARE_RALINK_RT2XX=y
BR2_PACKAGE_LINUX_FIRMWARE_RTL_81XX=y
BR2_PACKAGE_LINUX_FIRMWARE_RTL_87XX=y
BR2_PACKAGE_PYTHON=y
BR2_PACKAGE_LIBAO=y
BR2_PACKAGE_LIBVORBIS=y
BR2_PACKAGE_DTC=y
BR2_PACKAGE_DTC_PROGRAMS=y
BR2_PACKAGE_LIBXML2=y
BR2_PACKAGE_LIBCURL=y
BR2_PACKAGE_LIBGLIB2=y
BR2_PACKAGE_POPT=y
BR2_PACKAGE_AVAHI=y
BR2_PACKAGE_AVAHI_DAEMON=y
BR2_PACKAGE_AVAHI_LIBDNSSD_COMPATIBILITY=y
BR2_PACKAGE_OPENSSH=y
BR2_PACKAGE_WPA_SUPPLICANT=y
BR2_PACKAGE_WPA_SUPPLICANT_AUTOSCAN=y
BR2_PACKAGE_WPA_SUPPLICANT_CLI=y
BR2_PACKAGE_WPA_SUPPLICANT_PASSPHRASE=y
BR2_PACKAGE_WPA_SUPPLICANT_DBUS_NEW=y
BR2_PACKAGE_WPA_SUPPLICANT_DBUS_INTROSPECTION=y
BR2_PACKAGE_SYSTEMD_HIBERNATE=y
BR2_PACKAGE_UTIL_LINUX_LAST=y
BR2_PACKAGE_UTIL_LINUX_LOGIN=y
BR2_PACKAGE_UTIL_LINUX_RUNUSER=y
BR2_PACKAGE_UTIL_LINUX_SU=y
BR2_PACKAGE_UTIL_LINUX_SULOGIN=y
BR2_PACKAGE_VIM=y
BR2_PACKAGE_NLIMAGEMAKER=y
BR2_TARGET_ROOTFS_TAR_GZIP=y
BR2_PACKAGE_HOST_DTC=y
BR2_PACKAGE_HOST_UBOOT_TOOLS=y
BR2_PACKAGE_HOST_UTIL_LINUX=y
```

## configs/domestic_recorder_usbrescue_defconfig
```kconfig
BR2_arm=y
BR2_cortex_a8=y
BR2_JLEVEL=16
BR2_OPTIMIZE_3=y
BR2_TOOLCHAIN_BUILDROOT_GLIBC=y
BR2_KERNEL_HEADERS_4_4=y
BR2_GCC_VERSION_4_9_X=y
BR2_EXTRA_GCC_CONFIG_OPTIONS="--with-fpu=vfpv3 --with-float=hard"
BR2_TOOLCHAIN_BUILDROOT_CXX=y
BR2_TARGET_GENERIC_HOSTNAME="domestic-recorder"
BR2_TARGET_GENERIC_ISSUE="Domestic Recorder by Domestic Affairs"
BR2_INIT_SYSTEMD=y
BR2_SYSTEM_BIN_SH_BASH=y
BR2_GENERATE_LOCALE="en_US"
BR2_ROOTFS_OVERLAY="domestic_recorder/fs-overlay"
BR2_LINUX_KERNEL=y
BR2_LINUX_KERNEL_CUSTOM_GIT=y
BR2_LINUX_KERNEL_CUSTOM_REPO_URL="git@github.com:nonlinear-labs-dev/linux.git"
BR2_LINUX_KERNEL_CUSTOM_REPO_VERSION="nonlinear-am33xx-4.14.35"
BR2_LINUX_KERNEL_USE_CUSTOM_CONFIG=y
BR2_LINUX_KERNEL_CUSTOM_CONFIG_FILE="domestic_recorder/config/linux-4.4"
BR2_LINUX_KERNEL_UIMAGE=y
BR2_LINUX_KERNEL_UIMAGE_LOADADDR="0x80008000"
BR2_LINUX_KERNEL_INSTALL_TARGET=y
BR2_PACKAGE_BUSYBOX_SELINUX=y
BR2_PACKAGE_ALSA_UTILS=y
BR2_PACKAGE_FFMPEG=y
BR2_PACKAGE_FFMPEG_GPL=y
BR2_PACKAGE_FFMPEG_NONFREE=y
BR2_PACKAGE_FFMPEG_FFPLAY=y
BR2_PACKAGE_FFMPEG_FFSERVER=y
BR2_PACKAGE_FFMPEG_FFPROBE=y
BR2_PACKAGE_FFMPEG_AVRESAMPLE=y
BR2_PACKAGE_FFMPEG_POSTPROC=y
BR2_PACKAGE_FLAC=y
BR2_PACKAGE_LAME=y
BR2_PACKAGE_MPG123=y
BR2_PACKAGE_SOX=y
BR2_PACKAGE_VORBIS_TOOLS=y
BR2_PACKAGE_BZIP2=y
BR2_PACKAGE_GDB=y
BR2_PACKAGE_GDB_SERVER=y
BR2_PACKAGE_GDB_DEBUGGER=y
BR2_PACKAGE_GDB_TUI=y
BR2_PACKAGE_BINUTILS=y
BR2_PACKAGE_BINUTILS_TARGET=y
BR2_PACKAGE_CIFS_UTILS=y
BR2_PACKAGE_E2FSPROGS=y
BR2_PACKAGE_LINUX_FIRMWARE=y
BR2_PACKAGE_LINUX_FIRMWARE_RALINK_RT61=y
BR2_PACKAGE_LINUX_FIRMWARE_RALINK_RT73=y
BR2_PACKAGE_LINUX_FIRMWARE_RALINK_RT2XX=y
BR2_PACKAGE_LINUX_FIRMWARE_RTL_81XX=y
BR2_PACKAGE_LINUX_FIRMWARE_RTL_87XX=y
BR2_PACKAGE_PYTHON=y
BR2_PACKAGE_OPENSSL=y
BR2_PACKAGE_DTC=y
BR2_PACKAGE_DTC_PROGRAMS=y
BR2_PACKAGE_LIBXML2=y
BR2_PACKAGE_LIBNL=y
BR2_PACKAGE_LIBGLIB2=y
BR2_PACKAGE_POPT=y
BR2_PACKAGE_UTIL_LINUX_LAST=y
BR2_PACKAGE_UTIL_LINUX_LOGIN=y
BR2_PACKAGE_UTIL_LINUX_RUNUSER=y
BR2_PACKAGE_UTIL_LINUX_SU=y
BR2_PACKAGE_UTIL_LINUX_SULOGIN=y
BR2_PACKAGE_VIM=y
BR2_TARGET_ROOTFS_TAR_GZIP=y
BR2_PACKAGE_HOST_DTC=y
BR2_PACKAGE_HOST_UTIL_LINUX=y
```

## package/alsa2fifo/Config.in
```kconfig
config BR2_PACKAGE_ALSA2FIFO
       bool "alsa2fifo"
       help
         the Domestic Affairs alsa2fifo

	 http://www.domestic-affairs.de
```

## package/alsa_test_tool/Config.in
```kconfig
config BR2_PACKAGE_ALSA_TEST_TOOL
       bool "alsa_test_tool"
       help
         Very basic alsa test tool using snd_pcm_hw_params_test_rate and snd_pcm_hw_params_test_format

	 http://www.domestic-affairs.de
```

## package/authsae/Config.in
```kconfig
config BR2_PACKAGE_AUTHSAE
	bool "authsae"
	select BR2_PACKAGE_OPENSSL 
	select BR2_PACKAGE_LIBNL
	help
		SAE provides a secure password-based authentication mechanism for 802.11(s). It is resistant to passive attack, active attack, and dictionary attack.
```

## package/cpiped/Config.in
```kconfig
config BR2_PACKAGE_CPIPED
       bool "cpiped"
       help
         Captures an audio stream and outputs to a pipe with buffering and silence detection

	 https://github.com/b-fitzpatrick/cpiped
```

## package/crda/Config.in
```kconfig
config BR2_PACKAGE_CRDA
	bool "central regulatory domain agent"
	select BR2_PACKAGE_LIBNL
	select BR2_PACKAGE_OPENSSL
	select BR2_PACKAGE_UDEV
	select BR2_PACKAGE_WIRELESS_REGDB
	help
	  This is the Central Regulatory Domain Agent for Linux.
	  In essence it is a udev helper for communication between
	  the kernel and userspace.
```

## package/flashrom/Config.in
```kconfig
config BR2_PACKAGE_FLASHROM
	bool "flashrom"
	help
	  flashrom is a utility for identifying, reading, writing, verifying
	  and erasing flash chips. It's often used to flash
	  BIOS/EFI/coreboot/firmware images.

	  http://www.coreboot.org/Flashrom
```

## package/gnutls/Config.in
```kconfig
config BR2_PACKAGE_GNUTLS
	select BR2_PACKAGE_LIBGCRYPT
	bool "gnutls"
	help
	  gnutls is an HTTP client/server library. It implements the
	  proposed standards by the IETF's TLS working group. It uses
	  GObject and the GLib main loop, to integrate well with GNOME
	  applications.

	  http://www.gnu.org/software/gnutls/
```

## package/google-breakpad/Config.in
```kconfig
config BR2_PACKAGE_GOOGLE_BREAKPAD
	bool "google-breakpad"
	depends on BR2_INSTALL_LIBSTDCPP
	depends on BR2_TOOLCHAIN_USES_GLIBC
	help
	  An open-source multi-platform crash reporting system

	  http://code.google.com/p/google-breakpad/

comment "google-breakpad requires an (e)glibc toolchain with C++"
	depends on !(BR2_INSTALL_LIBSTDCPP && BR2_TOOLCHAIN_USES_GLIBC)
```

## package/gssdp/Config.in
```kconfig
config BR2_PACKAGE_GSSDP
	bool "gssdp"
	select BR2_PACKAGE_LIBSOUP
        select BR2_TOOLCHAIN_BUILDROOT_INET_ADDRCONFIG
	depends on BR2_USE_WCHAR
	help
          GSSDP implements resource discovery and announcement over SSDP.

	  http://www.gupnp.org

comment "gssdp requires a toolchain with WCHAR support"
	depends on !BR2_USE_WCHAR
```

## package/gstreamer1/gst1-libav/Config.in
```kconfig
config BR2_PACKAGE_GST1_LIBAV
	bool "gst1-libav"
	depends on BR2_PACKAGE_GSTREAMER1
	select BR2_PACKAGE_GST1_PLUGINS_BASE
	depends on BR2_LARGEFILE
	help
	  GStreamer plugin (formerly gst-ffmpeg).

	  This package is an implementation of the former
	  gst-ffmpeg plugin but there is a lot missing from it.
	  So far it only support decoding WMA and AAC.
	  
	  http://gstreamer.freedesktop.org/

comment "gst1-libav requires a toolchain with LARGEFILE support"
	depends on !(BR2_LARGEFILE)
```

## package/gupnp-igd/Config.in
```kconfig
config BR2_PACKAGE_GUPNP_IGD
	bool "gupnp-igd"
	default n
	depends on BR2_PACKAGE_GUPNP
	help
          GUPnP-IDG is a library to handle Internet Gateway Device
          port mappings.

          http://www.gupnp.org/
```

## package/gupnp/Config.in
```kconfig
config BR2_PACKAGE_GUPNP
	bool "gupnp"
	select BR2_PACKAGE_GSSDP
	select BR2_PACKAGE_LIBXML2
	select BR2_PACKAGE_UTIL_LINUX
	select BR2_PACKAGE_UTIL_LINUX_LIBUUID
	depends on BR2_LARGEFILE
	depends on BR2_USE_WCHAR
	help
	  GUPnP implements the UPnP specification: resource announcement
	  and discovery, description, control, event notification, and
	  presentation.

	  http://www.gupnp.org/

comment "gupnp requires a toolchain with LARGEFILE + WCHAR support"
	depends on !(BR2_LARGEFILE && BR2_USE_WCHAR)
```

## package/gvfs/Config.in
```kconfig
config BR2_PACKAGE_GVFS
	bool "gvfs"
	select BR2_PACKAGE_LIBGLIB2
        select BR2_PACKAGE_DBUS
        select BR2_PACKAGE_DBUS_GLIB
        select BR2_PACKAGE_SHARED_MIME_INFO

	help
		gvfs is a userspace virtual filesystem where mount runs as a
                separate processes which you talk to via D-Bus. It also
                contains a gio module that seamlessly adds gvfs support to
                all applications using the gio API. It also supports exposing
                the gvfs mounts to non-gio applications using fuse. 

		http://en.wikipedia.org/wiki/GVFS
```

## package/hostapd/Config.in
```kconfig
config BR2_PACKAGE_HOSTAPD
	bool "hostapd"
        select BR2_PACKAGE_LIBNL
        select BR2_PACKAGE_OPENSSL
        select BR2_PACKAGE_MADWIFI
	help
          user space daemon for access points, including, e.g., IEEE
	  802.1X/WPA/EAP Authenticator for number of Linux and BSD
          drivers, RADIUS client, integrated EAP server, and RADIUS
          authentication server

          http://hostap.epitest.fi/

config BR2_PACKAGE_HOSTAPD_CLI
	bool "Install hostapd_cli binary"
	depends on BR2_PACKAGE_HOSTAPD
	help
	  Install binary for command-line control of hostapd.

config BR2_PACKAGE_HOSTAPD_WPS
	bool "Enable support for WPS"
	depends on BR2_PACKAGE_HOSTAPD
	help
	  Enable support for Wi-Fi Protected Setup (WPS)
```

## package/iso-codes/Config.in
```kconfig
config BR2_ISO_CODES
	bool "iso-codes"
	select BR2_PACKAGE_GETTEXT if BR2_NEEDS_GETTEXT
	help
	  The iso-codes package provides lists of various ISO standards
	  (e.g. country, language, language scripts, and currency names).

	  http://pkg-isocodes.alioth.debian.org/
```

## package/libjson-sax/Config.in
```kconfig
config BR2_PACKAGE_LIBJSON_SAX
	bool "libjson-sax"
	help
	  A JSON parser and printer library in C.

	  https://github.com/vincenthz/libjson
```

## package/libsoup/Config.in
```kconfig
config BR2_PACKAGE_LIBSOUP
	bool "libsoup"
	select BR2_PACKAGE_LIBXML2
	select BR2_PACKAGE_LIBGLIB2
	help
	  libsoup is an HTTP client/server library. It uses GObject
	  and the GLib main loop, to integrate well with GNOME
	  applications.

	  http://live.gnome.org/LibSoup

config BR2_PACKAGE_LIBSOUP_SSL
	bool "ssl support"
	depends on BR2_PACKAGE_LIBSOUP
        select BR2_PACKAGE_GNUTLS
	help
	  Enable SSL support (needs gnutls)
```

## package/libunwind/Config.in
```kconfig
config BR2_PACKAGE_LIBUNWIND
	bool "libunwind"
	help
	  libunwind is a portable and efficient C programming
	  interface (API) to determine the call-chain of a program.
	  Useful for exception handling, debugging and introspection.

	  http://www.nongnu.org/libunwind/
```

## package/madwifi/Config.in
```kconfig
config BR2_PACKAGE_MADWIFI
	bool "madwifi"
	help
          advanced WLAN drivers
          http://madwifi-project.org/
```

## package/master-process/Config.in
```kconfig
config BR2_PACKAGE_RAUMFELD_MASTER_PROCESS
	bool "master-process"
	select BR2_PACKAGE_RAUMFELD
	help
	  raumfeld master-process

	  http://www.raumfeld.com/
```

## package/meta-server/Config.in
```kconfig
config BR2_PACKAGE_RAUMFELD_META_SERVER
	bool "meta-server"
	select BR2_PACKAGE_RAUMFELD
	select BR2_PACKAGE_RAUMFELDCPP
	help
	  raumfeld meta-server

	  http://www.raumfeld.com/
```

## package/mrouted/Config.in
```kconfig
config BR2_PACKAGE_MROUTED
	bool "mrouted"
	help
	  An implementation of the DVMRP multicast routing protocol.

	  http://github.com/troglobit/mrouted
```
