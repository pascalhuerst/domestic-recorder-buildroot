## package/multimedia/ffmpeg/Config.in
```kconfig
config BR2_PACKAGE_FFMPEG
	bool "ffmpeg"
	help
         FFmpeg is a complete, cross-platform solution to record, convert
         and stream audio and video. So far the buildroot ffmpeg package
         only builds libavcodec and libavformat. Support for other libraries
         contained in FFmpeg as well as support for the ffmpeg, ffplay and
         ffserver binaries could be added.

	 http://ffmpeg.org

config BR2_PACKAGE_FFMPEG_GPL
	bool "ffmpeg GPL code"
	default n
	help
         allow use of GPL code, the resulting libs and binaries will be
         under GPL

config BR2_PACKAGE_FFMPEG_NONFREE
	bool "ffmpeg nonfree code"
	default n
	help
         allow use of nonfree code, the resulting libs and binaries will
         be unredistributable

config BR2_PACKAGE_FFMPEG_POSTPROC
	bool "build ffmpeg libpostproc"
	default n
	help
         build libpostproc
         under GPL
```

## package/multimedia/gst-ffmpeg/Config.in
```kconfig
config BR2_PACKAGE_GST_FFMPEG
	bool "gst-ffmpeg"
	depends on BR2_PACKAGE_GSTREAMER
	select BR2_PACKAGE_GST_PLUGINS_BASE
	depends on BR2_LARGEFILE
	help
	  GStreamer plugin using FFmpeg.

	  http://gstreamer.freedesktop.org/

comment "gst-ffmpeg requires a toolchain with LARGEFILE support"
	depends on !(BR2_LARGEFILE)
```

## package/multimedia/gst-fluendo-mp3/Config.in
```kconfig
config BR2_PACKAGE_GST_FLUENDO_MP3
	bool "gst-fluendo.mp3"
	depends on BR2_PACKAGE_GSTREAMER 
	select BR2_PACKAGE_LIBOIL
	help
	  an alternative non GPL version of MP3 decoding using liboil

          http://www.fluendo.com/shop/product/fluendo-mp3-decoder/
```

## package/multimedia/gst-libav/Config.in
```kconfig
config BR2_PACKAGE_GST_LIBAV
	bool "gst-libav"
	depends on BR2_PACKAGE_GSTREAMER
	select BR2_PACKAGE_GST_PLUGINS_BASE
	depends on BR2_LARGEFILE
	help
	  GStreamer plugin (formerly gst-ffmpeg).

	  This package is an implementation of the former
	  gst-ffmpeg plugin but there is a lot missing from it.
	  So far it only support decoding WMA and AAC.
	  
	  http://gstreamer.freedesktop.org/

comment "gst-libav requires a toolchain with LARGEFILE support"
	depends on !(BR2_LARGEFILE)
```

## package/multimedia/libfaad2/Config.in
```kconfig
config BR2_PACKAGE_LIBFAAD2
	bool "libfaad2"
	default n
	help
          libfaad2 AC3 decoder

	  http://www.audiocoding.com/
```

## package/multimedia/taglib-extras/Config.in
```kconfig
config BR2_PACKAGE_TAGLIB_EXTRAS
	bool "taglib-extras"
	depends on BR2_PACKAGE_TAGLIB
	help
	  TagLib-Extras extends the taglib with support for wma, m4a, m4p, asf files.
```

## package/nettle/Config.in
```kconfig
config BR2_PACKAGE_NETTLE
	select BR2_PACKAGE_GMP
	bool "nettle"
	help
	  Nettle is a cryptographic library that is designed to fit
	  easily in more or less any context.

	  http://www.lysator.liu.se/~nisse/nettle/
```

## package/nlimagemaker/Config.in
```kconfig
config BR2_PACKAGE_NLIMAGEMAKER
       bool "nlimagemaker"
       help
         the NonlinearLabs Image Maker

	 http://www.nonlinear-labs.de
```

## package/opus/Config.in
```kconfig
config BR2_PACKAGE_OPUS
	bool "opus"
	help
	  The Opus codec is designed for interactive speech and audio
	  transmission over the Internet. It is designed by the IETF
	  Codec Working Group and incorporates technology from Skype's
	  SILK codec and Xiph.Org's CELT codec.

	  It is intended to suit a wide range of interactive audio
	  applications, including Voice over IP, videoconferencing,
	  in-game chat, and even remote live music performances. It
	  can scale from low bit-rate narrowband speech to very high
	  quality stereo music.

	  http://opus-codec.org


if BR2_PACKAGE_OPUS

	config BR2_PACKAGE_OPUS_FIXED_POINT
	bool "fixed-point implementation"
	default y if BR2_SOFT_FLOAT
	help
	  Compile without floating point operations (for machines without
	  a fast enough FPU).

	config BR2_PACKAGE_OPUS_FLOAT_APPROX
	bool "fast approximations for floating point"
	depends on !BR2_PACKAGE_OPUS_FIXED_POINT
	help
	  Enable fast approximations for floating point.

endif
```

## package/orc/Config.in
```kconfig
config BR2_PACKAGE_LIBORC
	bool "liborc"
	help
	  Orc is a library and set of tools for compiling and executing
          very simple programs that operate on arrays of data.

          http://code.entropywave.com/projects/orc/
```

## package/p0-renderer/Config.in
```kconfig
config BR2_PACKAGE_RAUMFELD_RENDERER
	bool "renderer"
	select BR2_PACKAGE_RAUMFELD
	select BR2_PACKAGE_GSTREAMER
	help
	  raumfeld renderer

	  http://www.raumfeld.com/
```

## package/p0-timeserver/Config.in
```kconfig
config BR2_PACKAGE_RAUMFELD_TIMESERVER
	bool "timeserver"
	select BR2_PACKAGE_RAUMFELD
	help
	  raumfeld timeserver

	  http://www.raumfeld.com/
```

## package/raumfeld/Config.in
```kconfig
menu "Raumfeld software"

source "package/raumfeld/raumfeld-repo/Config.in"

source "package/raumfeld/config-service/Config.in"
source "package/raumfeld/ethwatch/Config.in"
source "package/raumfeld/factory-tests/Config.in"
source "package/raumfeld/libraumfeld/Config.in"
source "package/raumfeld/libraumfeldcpp/Config.in"
source "package/raumfeld/libraumfelddsp/Config.in"
source "package/raumfeld/linux-config/Config.in"
source "package/raumfeld/loopbacktest/Config.in"
source "package/raumfeld/master-process/Config.in"
source "package/raumfeld/meta-server/Config.in"
source "package/raumfeld/raumfeld-dts/Config.in"
source "package/raumfeld/raumfeld-extract/Config.in"
source "package/raumfeld/raumfeld-firmware/Config.in"
source "package/raumfeld/remote-control/Config.in"
source "package/raumfeld/renderer/Config.in"
source "package/raumfeld/renderer-ng/Config.in"
source "package/raumfeld/report-daemon/Config.in"
source "package/raumfeld/sly-toolkit/Config.in"
source "package/raumfeld/stream-decoder/Config.in"
source "package/raumfeld/stream-relay/Config.in"
source "package/raumfeld/timeserver/Config.in"
source "package/raumfeld/web-service/Config.in"

endmenu
```

## package/raumfeld/config-service/Config.in
```kconfig
config BR2_PACKAGE_CONFIG_SERVICE
	bool "config-service"
	select BR2_PACKAGE_LIBRAUMFELDCPP
	help
	  Raumfeld config-service

	  http://www.raumfeld.com/
```

## package/raumfeld/debugtools/Config.in
```kconfig
config BR2_PACKAGE_DEBUGTOOLS
	bool "debugtools"
	help
	  Raumfeld debugging tools
          
	  http://www.raumfeld.com/
```

## package/raumfeld/ethwatch/Config.in
```kconfig
config BR2_PACKAGE_ETHWATCH
	bool "ethwatch"
	help
	  Raumfeld ethwatch daemon
          
	  http://www.raumfeld.com/
```

## package/raumfeld/factory-tests/Config.in
```kconfig
config BR2_PACKAGE_FACTORY_TESTS
	bool "factory-tests"
	select BR2_PACKAGE_ALSA_LIB
	select BR2_PACKAGE_LIBRAUMFELDDSP
	select BR2_PACKAGE_RAUMFELD_REPO
	help
	  Factory tests

	  http://www.raumfeld.com/
```

## package/raumfeld/gc4a/Config.in
```kconfig
config BR2_PACKAGE_GC4A
	bool "gc4a"
	help
	  Raumfeld gc4a integration 
          
	  http://www.raumfeld.com/
```

## package/raumfeld/libdspalsaplugin/Config.in
```kconfig
config BR2_PACKAGE_LIBDSPALSAPLUGIN
  bool "libdspalsaplugin"
  select BR2_PACKAGE_ALSA_LIB
  select BR2_PACKAGE_LIBRAUMFELD
  select BR2_PACKAGE_LIBRAUMFELDCPP
  select BR2_PACKAGE_LIBRAUMFELDDSP
  help
    libdspalsaplugin: use libraumfelddsp::Chain as alsa plugin

    http://www.raumfeld.com/
```

## package/raumfeld/libraumfeld/Config.in
```kconfig
config BR2_PACKAGE_LIBRAUMFELD
	bool "libraumfeld"
        select BR2_PACKAGE_AVAHI
        select BR2_PACKAGE_DBUS
	select BR2_PACKAGE_GSSDP
	select BR2_PACKAGE_GUPNP
	select BR2_PACKAGE_GUPNP_AV
        select BR2_PACKAGE_LIBGLIB2
        select BR2_PACKAGE_LIBARCHIVE
        select BR2_PACKAGE_LIBUNWIND
        select BR2_PACKAGE_OPENSSL
	select BR2_PACKAGE_RAUMFELD_REPO
        select BR2_PACKAGE_WPA_SUPPLICANT_DBUS_NEW if BR2_PACKAGE_WPA_SUPPLICANT
	help
	  libraumfeld is a utility library for the Raumfeld software stack

	  http://www.raumfeld.com/

config BR2_PACKAGE_LIBRAUMFELD_PROFILING
	bool "libraumfeld profiling support"
	depends on BR2_PACKAGE_LIBRAUMFELD
	help
	  Enable profiling support in libraumfeld and applications
	  linking against it. This enables instrumentalisation of
	  function calls and is somewhat expensive.
```

## package/raumfeld/libraumfeldcpp/Config.in
```kconfig
config BR2_PACKAGE_LIBRAUMFELDCPP
	bool "libraumfeldcpp"
	select BR2_PACKAGE_LIBRAUMFELD
	select BR2_INSTALL_LIBSTDCPP
	select BR2_PACKAGE_LIBSOUP
	select BR2_PACKAGE_LIBSOUP_SSL
	select BR2_PACKAGE_RAUMFELD_REPO
	help
	  libraumfeldcpp is a C++ utility library for the Raumfeld software
          stack

	  http://www.raumfeld.com/
```

## package/raumfeld/libraumfelddsp/Config.in
```kconfig
config BR2_PACKAGE_LIBRAUMFELDDSP
	bool "libraumfelddsp"
	select BR2_PACKAGE_LIBRAUMFELDCPP
	select BR2_PACKAGE_RAUMFELD_REPO
	help
	  libraumfelddsp is Raumfeld DSP library

	  http://www.raumfeld.com/
```

## package/raumfeld/libraumfeldspotify/Config.in
```kconfig
config BR2_PACKAGE_LIBRAUMFELDSPOTIFY
	bool "libraumfeldspotify"
	select BR2_PACKAGE_LIBRAUMFELDCPP
        select BR2_PACKAGE_SPOTIFY_EMBEDDED
	help
	  libraumfeldspotify are the Raumfeld Spotify bindings

	  http://www.raumfeld.com/
```

## package/raumfeld/libraumfeldtest/Config.in
```kconfig
config BR2_PACKAGE_LIBRAUMFELDTEST
	bool "libraumfeldtest"
	select BR2_PACKAGE_LIBRAUMFELDCPP
	select BR2_INSTALL_LIBSTDCPP
	help
	  libraumfeldtest is a test utility library for the Raumfeld software
          stack

	  http://www.raumfeld.com/
```

## package/raumfeld/linux-config/Config.in
```kconfig
config BR2_RAUMFELD_LINUX_CONFIG_BRIDGE
	bool "Ethernet bridging support"
	depends on BR2_LINUX_KERNEL

config BR2_RAUMFELD_LINUX_CONFIG_INPUT_UINPUT
       bool "User level input driver support"
       depends on BR2_LINUX_KERNEL

config BR2_RAUMFELD_LINUX_CONFIG_USB_AUDIO
	bool "USB audio support"
	depends on BR2_LINUX_KERNEL

config BR2_RAUMFELD_LINUX_CONFIG_MWIFIEX
	bool "Marvell WiFi-Ex wireless driver"
	depends on BR2_LINUX_KERNEL

config BR2_RAUMFELD_LINUX_CONFIG_MWIFIEX_SDIO
	bool "Marvell WiFi-Ex SDIO wireless module support"
	select BR2_PACKAGE_LINUX_FIRMWARE
	select BR2_PACKAGE_LINUX_FIRMWARE_MWIFIEX_SD8787
	depends on BR2_RAUMFELD_LINUX_CONFIG_MWIFIEX
	depends on BR2_LINUX_KERNEL

config BR2_RAUMFELD_LINUX_CONFIG_MWIFIEX_PCIE
	bool "Marvell WiFi-Ex PCIe wireless module support"
	depends on BR2_RAUMFELD_LINUX_CONFIG_MWIFIEX
	depends on BR2_LINUX_KERNEL
	select BR2_PACKAGE_LINUX_FIRMWARE
	select BR2_PACKAGE_LINUX_FIRMWARE_MWIFIEX_PCIE8897

config BR2_RAUMFELD_LINUX_CONFIG_RT2X00
	bool "Ralink RT2X00 wireless card support"
	depends on BR2_LINUX_KERNEL

config BR2_RAUMFELD_LINUX_CONFIG_RT2800USB_RT55XX
	bool "Ralink rt55xx USB wireless card support"
	select BR2_PACKAGE_LINUX_FIRMWARE
	select BR2_PACKAGE_LINUX_FIRMWARE_RALINK_RT2XX
	depends on BR2_RAUMFELD_LINUX_CONFIG_RT2X00
	depends on BR2_LINUX_KERNEL

config BR2_RAUMFELD_LINUX_CONFIG_CIFS
	bool "CIFS support"
	depends on BR2_LINUX_KERNEL
```
