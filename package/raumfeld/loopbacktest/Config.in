## package/raumfeld/loopbacktest/Config.in
```kconfig
config BR2_PACKAGE_LOOPBACKTEST
	bool "factory audiotest"
	select BR2_PACKAGE_ALSA_LIB
	select BR2_PACKAGE_LIBGLIB2
        select BR2_PACKAGE_RAUMFELD_REPOSITORY
	help
	  Raumfeld factory audiotest

	  http://www.raumfeld.com/
```

## package/raumfeld/master-process/Config.in
```kconfig
config BR2_PACKAGE_MASTER_PROCESS
	bool "master-process"
	select BR2_PACKAGE_CONNMAN
	select BR2_PACKAGE_CONNMAN_ETHERNET
	select BR2_PACKAGE_CONNMAN_WIFI
	select BR2_PACKAGE_LIBRAUMFELDCPP
	help
	  Raumfeld master process
          
	  http://www.raumfeld.com/
```

## package/raumfeld/mcu-protocol/Config.in
```kconfig
menuconfig BR2_PACKAGE_MCU_PROTOCOL
	bool "mcu-protocol"
	depends on BR2_arm
	help
	  Daemon, ALSA control plug-in and helper programs for Teufel MCU.

	  http://www.raumfeld.com/

if BR2_PACKAGE_MCU_PROTOCOL

config BR2_PACKAGE_MCU_PROTOCOL_DAEMON
	bool "mcu-protocol daemon and alsa plug-in"
	select BR2_PACKAGE_ALSA_LIB
	help
	  Build the rpfd and the ALSA control plug-in.

config BR2_PACKAGE_MCU_PROTOCOL_TOOLS
	bool "mcu-protocol command-line tools"
	help
	  Build the command-line utilities.

config BR2_PACKAGE_MCU_PROTOCOL_REPOSITORY
        string "git repository that holds the mcu-protocol source code"
        default "ssh://git@sources.teufelhome.com/rfs/mcu-protocol.git"

config BR2_PACKAGE_MCU_PROTOCOL_VERSION
        string "version or branch to check out from the git repository"
        default "master"

endif
```

## package/raumfeld/mcud/Config.in
```kconfig
config BR2_PACKAGE_MCUD
	bool "mcud"
	select BR2_PACKAGE_LIBRAUMFELDCPP
	select BR2_PACKAGE_SOCAT
	help
	  Raumfeld mcud next generation

	  http://www.raumfeld.com/
```

## package/raumfeld/meta-server/Config.in
```kconfig
config BR2_PACKAGE_META_SERVER
	bool "meta-server"
	select BR2_PACKAGE_GNUTLS
	select BR2_PACKAGE_LIBRAUMFELD
	select BR2_PACKAGE_LIBRAUMFELDCPP
        select BR2_PACKAGE_TAGLIB
        select BR2_PACKAGE_TAGLIB_ASF
        select BR2_PACKAGE_TAGLIB_MP4
	select BR2_PACKAGE_RAUMFELD_REPO
	help
	  Raumfeld meta-server

	  http://www.raumfeld.com/
```

## package/raumfeld/p0-renderer/Config.in
```kconfig
config BR2_PACKAGE_P0_RENDERER
	bool "p0-renderer"
	select BR2_PACKAGE_ALSA_LIB
	select BR2_PACKAGE_FLAC
	select BR2_PACKAGE_LIBRAUMFELD
	select BR2_PACKAGE_STREAM_DECODER
	help
	  Raumfeld renderer

	  http://www.raumfeld.com/
```

## package/raumfeld/p0-timeserver/Config.in
```kconfig
config BR2_PACKAGE_P0_TIMESERVER
	bool "p0-timeserver"
	select BR2_PACKAGE_LIBRAUMFELD
	help
	  Raumfeld time-server

	  http://www.raumfeld.com/
```

## package/raumfeld/raumfeld-certificates/Config.in
```kconfig
config BR2_PACKAGE_RAUMFELD_CERTIFICATES
	bool "raumfeld-certificates"
	select BR2_PACKAGE_CA_CERTIFICATES
	help
	  This package provides the Raumfeld certificates.
```

## package/raumfeld/raumfeld-dts/Config.in
```kconfig
menuconfig BR2_PACKAGE_RAUMFELD_DTS
	bool "raumfeld-dts"
	depends on BR2_arm
	help
	  Pulls the DTS files from our git repository and compiles them.

	  http://www.raumfeld.com/

if BR2_PACKAGE_RAUMFELD_DTS

config BR2_PACKAGE_RAUMFELD_DTS_REPOSITORY
        string "git repository that holds the dts files"
        default "ssh://git@sources.teufelhome.com/rfs/dts.git"

config BR2_PACKAGE_RAUMFELD_DTS_VERSION
        string "version or branch to check out from the git repository"
        default "raumfeld-am33xx-3.9"

endif
```

## package/raumfeld/raumfeld-extract/Config.in
```kconfig
menuconfig BR2_PACKAGE_RAUMFELD_EXTRACT
	bool "raumfeld-extract"
        select BR2_PACKAGE_LIBARCHIVE
	help
	  raumfeld-extract is a utility to extract an update

	  http://www.raumfeld.com/

if BR2_PACKAGE_RAUMFELD_RAUMFELD_EXTRACT

config BR2_PACKAGE_RAUMFELD_EXTRACT_REPOSITORY
        string "git repository that holds raumfeld-extract source"
        default "ssh://git@sources.teufelhome.com/rfs/raumfeld-extract.git"

config BR2_PACKAGE_RAUMFELD_EXTRACT_VERSION
        string "version or branch to check out from the git repository"
        default "master"

endif
```

## package/raumfeld/raumfeld-firmware/Config.in
```kconfig
config BR2_PACKAGE_RAUMFELD_FIRMWARE
	bool "raumfeld-firmware"
	help
	  This package provides various binary firmware files (closed binary blobs).

if BR2_PACKAGE_RAUMFELD_FIRMWARE

config BR2_PACKAGE_RAUMFELD_FIRMWARE_ADAU1701
	bool "ADAU1701"
	default n
	help
	  Firmware for ADAU1701 SigmaDSP processor

config BR2_PACKAGE_RAUMFELD_FIRMWARE_PCIE8897
	bool "PCIE8897"
	default n
	help
	  Firmware for Marvell's PCIe based wifi chip
endif
```

## package/raumfeld/raumfeld-repo/Config.in
```kconfig
config BR2_PACKAGE_RAUMFELD_REPO
	bool "raumfeld git repository"
	help
	  This package takes care of checking out and updating the
	  Raumfeld source repository. It serves as a dependency for
	  the other Raumfeld packages.

	  http://www.raumfeld.com/

config BR2_PACKAGE_RAUMFELD_REPO_LOCATION
	string "raumfeld git location"
	default "ssh://git@sources.teufelhome.com/rfs/core.git"
	help
	  location of the Raumfeld git repository 

config BR2_PACKAGE_RAUMFELD_REPO_VERSION
	string "raumfeld git branch, tag or commit ID"
	default "master"
	help
	  version to checkout from the git repository
```

## package/raumfeld/raumfeld-setup/Config.in
```kconfig
config BR2_PACKAGE_RAUMFELD_SETUP
	bool "raumfeld-setup"
	select BR2_PACKAGE_CONNMAN
	select BR2_PACKAGE_CONNMAN_ETHERNET
	select BR2_PACKAGE_CONNMAN_WIFI
	select BR2_PACKAGE_LIBRAUMFELDCPP
	select BR2_PACKAGE_RAUMFELD_REPO
	help
	  Raumfeld setup service
          
	  http://www.raumfeld.com/
```

## package/raumfeld/raumfeld-uboot-tools-env/Config.in
```kconfig
config BR2_PACKAGE_RAUMFELD_UBOOT_TOOLS_ENV
	bool "raumfeld-uboot-tools-env"
	select BR2_PACKAGE_UBOOT_TOOLS
	help
	  This package installs fw_env.config file required for U-boot Tools package.
```

## package/raumfeld/remote-control/Config.in
```kconfig
config BR2_PACKAGE_REMOTE_CONTROL
	bool "remote-control"
	select BR2_PACKAGE_GETTEXT if BR2_NEEDS_GETTEXT_IF_LOCALE
	select BR2_PACKAGE_LIBRAUMFELD
	select BR2_PACKAGE_SLY_TOOLKIT
	help
	  The remote control software

	  http://www.raumfeld.com/
```

## package/raumfeld/renderer-ng/Config.in
```kconfig
config BR2_PACKAGE_RENDERER_NG
	bool "renderer-ng"
	select BR2_PACKAGE_ALSA_LIB
	select BR2_PACKAGE_FLAC
	select BR2_PACKAGE_LIBRAUMFELDDSP
        select BR2_PACKAGE_KMOD
	select BR2_PACKAGE_SPOTIFY_EMBEDDED
	select BR2_PACKAGE_STREAM_DECODER
	select BR2_PACKAGE_RAUMFELD_REPO
	help
	  Raumfeld renderer next generation

	  http://www.raumfeld.com/
```

## package/raumfeld/renderer/Config.in
```kconfig
config BR2_PACKAGE_RENDERER
	bool "renderer"
	select BR2_PACKAGE_ALSA_LIB
	select BR2_PACKAGE_FLAC
	select BR2_PACKAGE_LIBRAUMFELDCPP
	select BR2_PACKAGE_LIBRAUMFELDDSP
	select BR2_PACKAGE_LIBRAUMFELDSPOTIFY
        select BR2_PACKAGE_KMOD
	select BR2_PACKAGE_STREAM_DECODER
	help
	  Raumfeld renderer next generation

	  http://www.raumfeld.com/
```

## package/raumfeld/report-daemon/Config.in
```kconfig
config BR2_PACKAGE_REPORT_DAEMON
	bool "report-daemon"
	select BR2_PACKAGE_LIBSOUP
	help
	  Raumfeld report-daemon

	  http://www.raumfeld.com/
```

## package/raumfeld/select-wlan-channel/Config.in
```kconfig
config BR2_PACKAGE_SELECT_WLAN_CHANNEL
	bool "select-wlan-channel"
	help
	  Raumfeld select-wlan-channel tool
          
	  http://www.raumfeld.com/
```

## package/raumfeld/sly-toolkit/Config.in
```kconfig
config BR2_PACKAGE_SLY_TOOLKIT
	bool "sly-toolkit"
	select BR2_PACKAGE_DIRECTFB
	select BR2_PACKAGE_LIBGLIB2
	select BR2_PACKAGE_RAUMFELD_REPO
	help
	  sly-toolkit is a toolkit based on DirectFB

	  http://www.raumfeld.com/
```

## package/raumfeld/spotify-embedded/Config.in
```kconfig
config BR2_PACKAGE_SPOTIFY_EMBEDDED
	bool "spotify-embedded"
	help
		spotify embedded library
```

## package/raumfeld/stream-decoder/Config.in
```kconfig
config BR2_PACKAGE_STREAM_DECODER
	bool "stream-decoder"
	select BR2_INSTALL_LIBSTDCPP
	select BR2_PACKAGE_GSTREAMER1
	select BR2_PACKAGE_LIBSOUP
	help
	  The stream decoder software

	  http://www.raumfeld.com/
```

## package/raumfeld/stream-relay/Config.in
```kconfig
config BR2_PACKAGE_STREAM_RELAY
	bool "stream-relay"
	select BR2_PACKAGE_GNUTLS
	select BR2_PACKAGE_LIBRAUMFELD
	select BR2_PACKAGE_LIBRAUMFELDCPP
	select BR2_PACKAGE_LIBRAUMFELDSPOTIFY
        select BR2_PACKAGE_LIBASF
        select BR2_PACKAGE_LIBMMS
        select BR2_PACKAGE_LIBVORBIS
        select BR2_PACKAGE_TAGLIB
	help
	  Raumfeld stream-relay

	  http://www.raumfeld.com/
```

## package/raumfeld/timeserver/Config.in
```kconfig
config BR2_PACKAGE_TIMESERVER
	bool "timeserver"
	select BR2_PACKAGE_LIBRAUMFELD
	select BR2_PACKAGE_RAUMFELD_REPO
	help
	  Raumfeld time server

	  http://www.raumfeld.com/
```

## package/raumfeld/uboot-signed/Config.in
```kconfig
menuconfig BR2_PACKAGE_UBOOT_SIGNED
	bool "uboot-signed"
	depends on BR2_TARGET_UBOOT
	help
	  Pulls the certificates from our repository and sign the u-boot.imx
          binary using them.

	  http://www.raumfeld.com/

if BR2_PACKAGE_UBOOT_SIGNED

config BR2_PACKAGE_RAUMFELD_CST_REPOSITORY
        string "git repository that holds the signing tools"
        default "ssh://git@sources.teufelhome.com/rus/u-boot-signing.git"

config BR2_PACKAGE_RAUMFELD_CST_VERSION
        string "version or branch to check out from the git repository"
        default "master"

endif
```
