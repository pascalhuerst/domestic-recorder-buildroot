## package/raumfeld/web-service/Config.in
```kconfig
config BR2_PACKAGE_WEB_SERVICE
	bool "web-service"
	select BR2_PACKAGE_LIBRAUMFELD
	select BR2_PACKAGE_LIBRAUMFELDCPP
	help
	  Raumfeld web-service

	  http://www.raumfeld.com/
```

## package/raumfeldcpp/Config.in
```kconfig
config BR2_PACKAGE_RAUMFELDCPP
	bool "raumfeldcpp"
	depends on BR2_PACKAGE_RAUMFELD
	select BR2_INSTALL_LIBSTDCPP
	select BR2_PACKAGE_LIBSOUP
	help
	  raumfeldcpp is a C++ utility library for the Raumfeld software stack

	  http://www.raumfeld.com/

config BR2_PACKAGE_RAUMFELDCPP_BRANCH
	string "raumfeldcpp branch"
	default "trunk"
	depends on BR2_PACKAGE_RAUMFELDCPP
	help
	  branch to checkout from the bazaar repository
```

## package/remote-control/Config.in
```kconfig
config BR2_PACKAGE_REMOTE_CONTROL
	bool "remote-control"
	default n
        select BR2_PACKAGE_RAUMFELD
        select BR2_PACKAGE_SLY_TOOLKIT
	help
          The remote control software

          http://www.raumfeld.com/

config BR2_PACKAGE_REMOTE_CONTROL_BRANCH
        string
        default "trunk"
	help
          branch to checkout from the bazaar repository
```

## package/sly-toolkit/Config.in
```kconfig
config BR2_PACKAGE_SLY_TOOLKIT
	bool "sly-toolkit"
        depends on BR2_PACKAGE_RAUMFELD
        select BR2_PACKAGE_DIRECTFB
        select BR2_PACKAGE_LIBGLIB2
	help
          sly-toolkit is a toolkit based on DirectFB

          http://www.raumfeld.com/

config BR2_PACKAGE_SLY_TOOLKIT_BRANCH
        string
        default "trunk"
        depends on BR2_PACKAGE_SLY_TOOLKIT
	help
          branch to checkout from the bazaar repository
```

## package/stm32flash/Config.in
```kconfig
config BR2_PACKAGE_STM32FLASH
	bool "stm32flash"
	help
	  Tool to flash STM32 micro controllers via UART or I2C.

	  https://code.google.com/p/stm32flash/
```

## package/stream-relay/Config.in
```kconfig
config BR2_PACKAGE_RAUMFELD_STREAM_RELAY
	bool "stream-relay"
	select BR2_PACKAGE_RAUMFELD
	select BR2_PACKAGE_RAUMFELDCPP
	help
	  raumfeld stream relay

	  http://www.raumfeld.com/
```

## package/udev/Config.in
```kconfig
config BR2_PACKAGE_UDEV
	bool "udev"
	depends on BR2_ROOTFS_DEVICE_CREATION_DYNAMIC_UDEV
	depends on BR2_LARGEFILE # util-linux
	depends on BR2_USE_WCHAR # util-linux
	select BR2_PACKAGE_UTIL_LINUX
	select BR2_PACKAGE_UTIL_LINUX_LIBBLKID
	select BR2_PACKAGE_KMOD
	help
	  Userspace device daemon.

	  udev requires a Linux kernel >= 2.6.34: it relies on devtmpfs.

	  ftp://ftp.kernel.org/pub/linux/utils/kernel/hotplug/

if BR2_PACKAGE_UDEV

config BR2_PACKAGE_UDEV_ACL
	bool "enable acl permissions"
	help
	  Enable enable local user acl permissions support

config BR2_PACKAGE_UDEV_GUDEV
	bool "enable GObject libudev support"
	help
	  Enable GObject libudev support

config BR2_PACKAGE_UDEV_HWDATA
	bool "enable hardware data"
	help
	  Enable hardware identification and configuration data

config BR2_PACKAGE_UDEV_INTROSPECTION
	bool "enable GObject introspection"
	help
	  Enable GObject introspection support

config BR2_PACKAGE_UDEV_KEYMAP
	bool "enable keymap fixup"
	help
	  Enable keymap fixup support

config BR2_PACKAGE_UDEV_MTD
	bool "enable MTD support"
	help
	  Enable MTD probe support

config BR2_PACKAGE_UDEV_RULES_GEN
	bool "enable rules generator"
	help
	  Enable persistant rules generator

endif

comment "udev requires /dev mgmnt set to udev under System configuration"
	depends on !BR2_ROOTFS_DEVICE_CREATION_DYNAMIC_UDEV
```

## package/wireless-regdb/Config.in
```kconfig
config BR2_PACKAGE_WIRELESS_REGDB
	bool "wireless regulatory database"
	help
	  This installs the binary version of the regulatory database
	  file for use with Central Regulatory Database Agent daemon.
```
